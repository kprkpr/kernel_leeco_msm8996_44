## drivers/misc/cclogic/Kconfig
```kconfig
#
# cclogic devices for type-C connector
#
menuconfig CCLOGIC
	tristate "cclogic devices for Type-C connector"
	depends on I2C
	help
	  This is cclogic devices for Type-C connector.

if CCLOGIC

config TYPEC_CCLOGIC_PI5USBD
	depends on I2C
	tristate "Pericom Pi5usb30216d Support"
	---help---
	  The Pericom pi5usb30216d chip is used as cc-logic of TYPEC 
	  interface.

config TYPEC_CCLOGIC_TUSB320HAI
	depends on I2C
	tristate "TI TUSB320Hai Support"
	---help---
	  The TI tusb320hai chip is used as cc-logic of TYPEC 

config USB_CCLOGIC_PI5USB
	bool "USB cc logic PI5USB"
	help
	  This driver is for cc logic chip PI5USB

config USB_CCLOGIC_TUSB302L
	bool "USB cc logic TUSB302L"
	help
	  This driver is for cc logic chip TUSB302L

config USB_CCLOGIC_PTN5150
	bool "USB cc logic PTN5150"
	help
	  This driver is for cc logic chip PTN5150

config USB_CCLOGIC_PER30216
	bool "USB cc logic PERICOM30216"
	help
	  This driver is for cc logic chip PERICOM30216

config USB_CCLOGIC_TUSB320
	bool "USB cc logic TUSB320"
	help
	  This driver is for cc logic chip TUSB320


endif # CCLOGIC
```
